## CMakeLists.txt
```
#
# Copyright (c) 2024 Nordic Semiconductor
#
# SPDX-License-Identifier: LicenseRef-Nordic-5-Clause
#

cmake_minimum_required(VERSION 3.20.0)

find_package(Zephyr REQUIRED HINTS $ENV{ZEPHYR_BASE})
project(dect-nr)

target_sources(app PRIVATE src/main.c)
target_sources(app PRIVATE src/mesh.c)
target_sources(app PRIVATE src/mesh-root.c)
target_sources(app PRIVATE src/dect-nr.c)
target_sources(app PRIVATE src/uart.c)
```

## Kconfig
```
#
# Copyright (c) 2024 Nordic Semiconductor
#
# SPDX-License-Identifier: LicenseRef-Nordic-5-Clause
#

config CARRIER
	int "Carrier to use"
	default 0
	help
	   The availability of the channels and the exact regulation to use them varies in different countries.
	   See ETSI TS 103 636-2 5.4.2 for the calculation.

config NETWORK_ID
	int "Network ID"
	range 1 4294967295
	default 91

config MCS
	int "MCS"
	default 1
	help
	   The MCS impacts how much data can fit into each subslot.

config TX_POWER
	int "TX power"
	range 0 13
	default 13
	help
	   Transmission power, max 19 dBm due to hardware limitations.
	   See table 6.2.1-3 of ETSI TS 103 636-4 v1.5.1.

config TX_TRANSMISSIONS
	int "TX transmissions"
	range 0 4294967295
	default 30
	help
	   Transmissions before sample exits, use 0 to transmit forever.

config RX_PERIOD_MS
	int "RX period"
	default 5000
	help
	   Receive window period.
	   Time is given in miliseconds.

config TRACKER_PERIODIC_INTERVAL
	int "Fix interval for periodic GPS fixes. This determines your tracking frequency"
	range 10 65535
	default 120
	help
	  Fix interval (in seconds) for periodic fixes.

config TRACKER_PERIODIC_TIMEOUT
	int "Fix timeout for periodic GPS fixes"
	range 0 65535
	default 600
	help
	  Fix timeout (in seconds) for periodic fixes.
	  If set to zero, GNSS is allowed to run indefinitely until a valid PVT estimate is produced.

config GNSS_LOW_ACCURACY
	bool "Allow low accuracy fixes."
	help
	  Helps with faster fixes.GNSS demonstrates a looser acceptance criterion for a fix.

config GNSS_HIGH_ACCURACY_TIMING_SOURCE
	bool "Use Crystal oscillator"
	help
	  Use crystal oscillator (TCXO) timing source for the GNSS interface 
	  instead of the default Real time clock (RTC).TCXO has higher power consumption than RTC


module = DECT_PHY_HELLO
module-str = DECT NR+ PHY Hello
source "${ZEPHYR_BASE}/subsys/logging/Kconfig.template.log_config"

menu "Zephyr Kernel"
source "Kconfig.zephyr"
endmenu
```

## sample.yaml
```
sample:
  name: Bike Sharing Mesh Component
tests:
  sample.dect_phy.dect_hello.eu.sysbuild:
    sysbuild: true
    build_only: true
    integration_platforms:
      - nrf9151dk/nrf9151/ns
      - nrf9161dk/nrf9161/ns
    platform_allow:
      - nrf9151dk/nrf9151/ns
      - nrf9161dk/nrf9161/ns
    extra_args: EXTRA_CONF_FILE="overlay-eu.conf"
    tags: ci_build sysbuild
  sample.dect_phy.dect_hello.us.sysbuild:
    sysbuild: true
    build_only: true
    integration_platforms:
      - nrf9151dk/nrf9151/ns
      - nrf9161dk/nrf9161/ns
    platform_allow:
      - nrf9151dk/nrf9151/ns
      - nrf9161dk/nrf9161/ns
    extra_args: EXTRA_CONF_FILE="overlay-us.conf"
    tags: ci_build sysbuild
```

## prj.conf
```kconfig
# Button and LED support
CONFIG_DK_LIBRARY=y

# NewLib C
CONFIG_NEWLIB_LIBC=y

# Floating point support
CONFIG_NEWLIB_LIBC_FLOAT_PRINTF=y
CONFIG_FPU=y

# Modem
CONFIG_NRF_MODEM_LIB=y
CONFIG_MODEM_ANTENNA=n

# HWInfo
CONFIG_HWINFO=y

# Logging
CONFIG_LOG=y

# DECT-NR+
CONFIG_NRF_MODEM_LINK_BINARY_DECT_PHY=y
CONFIG_RX_PERIOD_MS=100
CONFIG_CARRIER=1706
CONFIG_TX_POWER=4
CONFIG_TX_TRANSMISSIONS=0

# Memory
CONFIG_HEAP_MEM_POOL_SIZE=4096
CONFIG_MAIN_STACK_SIZE=4096

# UART
CONFIG_LOG_MODE_DEFERRED=y
CONFIG_SERIAL=y
CONFIG_UART_ASYNC_API=y
CONFIG_UART_1_INTERRUPT_DRIVEN=n
CONFIG_TFM_SECURE_UART=n
CONFIG_TFM_LOG_LEVEL_SILENCE=y
CONFIG_THREAD_NAME=y
```

## nrf9161dk_nrf9161_ns.overlay
```dts
// To get started, press Ctrl+Space to bring up the completion menu and view the available nodes.

// You can also use the buttons in the sidebar to perform actions on nodes.
// Actions currently available include:

// * Enabling / disabling the node
// * Adding the bus to a bus
// * Removing the node
// * Connecting ADC channels

// For more help, browse the DeviceTree documentation at https://docs.zephyrproject.org/latest/guides/dts/index.html
// You can also visit the nRF DeviceTree extension documentation at https://docs.nordicsemi.com/bundle/nrf-connect-vscode/page/guides/ncs_configure_app.html#devicetree-support-in-the-extension
&uart1 {
    status = "okay";
    current-speed = <9600>;
};
```

## src/main.c
```c
#ifndef UART_H_
#include "uart.h"
#endif
#ifndef MESH_H_
#include "mesh.h"
#endif
#ifndef MESHR_H_
#include "mesh-root.h"
#endif
#include <stdlib.h>

data_point point;
LOG_MODULE_REGISTER(main_module, LOG_LEVEL_INF);
int fake_thread(data_point* dpoint){
    LOG_INF("test");
    dpoint->latitude = 0.0f;
    dpoint->longitude = 0.0f;
    while(1){
        LOG_INF("test1");
        dpoint->latitude++;
        dpoint->longitude++;
        k_msleep(500);
    }
}

K_SEM_DEFINE(mesh_sem, 1, 1);
bool is_root = false;

//update_point device_locks[NUM_DEVICES];
sys_dlist_t devices;


K_THREAD_DEFINE(UART_thread, 2048, uart_main, &point, &devices, NULL, 1, 0, 0);




K_THREAD_DEFINE(MESH_thread_node, 2048, mesh_node, &point, &mesh_sem, NULL, 0, 0, 0);



K_THREAD_DEFINE(MESH_thread_root, 2048, mesh_root, &mesh_sem, &point, &devices, 0, 0, 0);




int switch_node_root(void){
    if(is_root) {
        is_root = false;
        mesh_root_switch_init();
        k_thread_resume(MESH_thread_root);
        k_thread_suspend(MESH_thread_node);
    } else {
        is_root = true;
        mesh_node_switch_init();
        k_thread_resume(MESH_thread_node);
        k_thread_suspend(MESH_thread_root);
    }
    return 0;
}

//#define IS_ROOT
```

## src/dect-nr.c
```c
/*
 * Copyright (c) 2024 Nordic Semiconductor ASA
 *
 * SPDX-License-Identifier: LicenseRef-Nordic-5-Clause
 */
#include <string.h>
#include <zephyr/kernel.h>
#include <zephyr/logging/log.h>
#include <nrf_modem_dect_phy.h>
#include <modem/nrf_modem_lib.h>
#include <zephyr/drivers/hwinfo.h>
#include "dect-nr.h"

LOG_MODULE_REGISTER(DECT_Module, LOG_LEVEL_ERR);



dect_callback_t receipt_callback;

static bool exit;
uint16_t device_id;

/* Semaphore to synchronize modem calls. */
K_SEM_DEFINE(operation_sem, 0, 1);

/* Callback after init operation. */
static void init(const uint64_t *time, int16_t temp, enum nrf_modem_dect_phy_err err,
	  const struct nrf_modem_dect_phy_modem_cfg *cfg)
{
	if (err) {
		LOG_ERR("Init failed, err %d", err);
		exit = true;
		return;
	}

	k_sem_give(&operation_sem);
}

/* Callback after deinit operation. */
static void deinit(const uint64_t *time, enum nrf_modem_dect_phy_err err)
{
	if (err) {
		LOG_ERR("Deinit failed, err %d", err);
		return;
	}

	k_sem_give(&operation_sem);
}

/* Operation complete notification. */
static void op_complete(const uint64_t *time, int16_t temperature,
		 enum nrf_modem_dect_phy_err err, uint32_t handle)
{
	LOG_DBG("op_complete cb time %"PRIu64" status %d", *time, err);
	k_sem_give(&operation_sem);
}

/* Callback after receive stop operation. */
static void rx_stop(const uint64_t *time, enum nrf_modem_dect_phy_err err, uint32_t handle)
{
	LOG_DBG("rx_stop cb time %"PRIu64" status %d handle %d", *time, err, handle);
	k_sem_give(&operation_sem);
}

/* Physical Control Channel reception notification. */
static void pcc(
	const uint64_t *time,
	const struct nrf_modem_dect_phy_rx_pcc_status *status,
	const union nrf_modem_dect_phy_hdr *hdr)
{
	struct phy_ctrl_field_common *header = (struct phy_ctrl_field_common *)hdr->type_1;

	LOG_INF("Received header from device ID %d",
		header->transmitter_id_hi << 8 |  header->transmitter_id_lo);
}

/* Physical Control Channel CRC error notification. */
static void pcc_crc_err(const uint64_t *time,
		 const struct nrf_modem_dect_phy_rx_pcc_crc_failure *crc_failure)
{
	LOG_DBG("pcc_crc_err cb time %"PRIu64"", *time);
}

/* Physical Data Channel reception notification. */
static void pdc(const uint64_t *time,
		const struct nrf_modem_dect_phy_rx_pdc_status *status,
		const void *data, uint32_t len)
{
	/* Received RSSI value is in fixed precision format Q14.1 */
	LOG_INF("Received data (RSSI: %d.%d)",
		(status->rssi_2 / 2), (status->rssi_2 & 0b1) * 5);
    dect_data_callback(data, status->snr);
}

/* Physical Data Channel CRC error notification. */
static void pdc_crc_err(
	const uint64_t *time, const struct nrf_modem_dect_phy_rx_pdc_crc_failure *crc_failure)
{
	LOG_DBG("pdc_crc_err cb time %"PRIu64"", *time);
}

/* RSSI measurement result notification. */
static void rssi(const uint64_t *time, const struct nrf_modem_dect_phy_rssi_meas *status)
{
	LOG_DBG("rssi cb time %"PRIu64" carrier %d", *time, status->carrier);
}

/* Callback after link configuration operation. */
static void link_config(const uint64_t *time, enum nrf_modem_dect_phy_err err)
{
	LOG_DBG("link_config cb time %"PRIu64" status %d", *time, err);
}

/* Callback after time query operation. */
static void time_get(const uint64_t *time, enum nrf_modem_dect_phy_err err)
{
	LOG_DBG("time_get cb time %"PRIu64" status %d", *time, err);
}

/* Callback after capability get operation. */
static void capability_get(const uint64_t *time, enum nrf_modem_dect_phy_err err,
		    const struct nrf_modem_dect_phy_capability *capability)
{
	LOG_DBG("capability_get cb time %"PRIu64" status %d", *time, err);
}

/* Dect PHY callbacks. */
static struct nrf_modem_dect_phy_callbacks dect_phy_callbacks = {
	.init = init,
	.deinit = deinit,
	.op_complete = op_complete,
	.rx_stop = rx_stop,
	.pcc = pcc,
	.pcc_crc_err = pcc_crc_err,
	.pdc = pdc,
	.pdc_crc_err = pdc_crc_err,
	.rssi = rssi,
	.link_config = link_config,
	.time_get = time_get,
	.capability_get = capability_get,
};

/* Dect PHY init parameters. */
static struct nrf_modem_dect_phy_init_params dect_phy_init_params = {
	.harq_rx_expiry_time_us = 5000000,
	.harq_rx_process_count = 4,
};

/* Send operation. */
static int transmit(uint32_t handle, void *data, size_t data_len)
{
	int err;

	struct phy_ctrl_field_common header = {
		.header_format = 0x0,
		.packet_length_type = 0x0,
		.packet_length = 0x1,
		.short_network_id = (CONFIG_NETWORK_ID & 0xff),
		.transmitter_id_hi = (device_id >> 8),
		.transmitter_id_lo = (device_id & 0xff),
		.transmit_power = CONFIG_TX_POWER,
		.reserved = 0,
		.df_mcs = CONFIG_MCS,
	};

	struct nrf_modem_dect_phy_tx_params tx_op_params = {
		.start_time = 0,
		.handle = handle,
		.network_id = CONFIG_NETWORK_ID,
		.phy_type = 0,
		.lbt_rssi_threshold_max = 0,
		.carrier = CONFIG_CARRIER,
		.lbt_period = NRF_MODEM_DECT_LBT_PERIOD_MAX,
		.phy_header = (union nrf_modem_dect_phy_hdr *)&header,
		.data = data,
		.data_size = data_len,
	};

	err = nrf_modem_dect_phy_tx(&tx_op_params);
	if (err != 0) {
		return err;
	}

	return 0;
}

/* Receive operation. */
static int receive(uint32_t handle, bool stop_after_receipt)
{
	int err;

	struct nrf_modem_dect_phy_rx_params rx_op_params = {
		.start_time = 0,
		.handle = handle,
		.network_id = CONFIG_NETWORK_ID,
		.mode = stop_after_receipt ? NRF_MODEM_DECT_PHY_RX_MODE_SINGLE_SHOT : NRF_MODEM_DECT_PHY_RX_MODE_CONTINUOUS,
		.rssi_interval = NRF_MODEM_DECT_PHY_RSSI_INTERVAL_OFF,
		.link_id = NRF_MODEM_DECT_PHY_LINK_UNSPECIFIED,
		.rssi_level = 0,
		.carrier = CONFIG_CARRIER,
		.duration = CONFIG_RX_PERIOD_MS *
			    NRF_MODEM_DECT_MODEM_TIME_TICK_RATE_KHZ,
		.filter.short_network_id = CONFIG_NETWORK_ID & 0xff,
		.filter.is_short_network_id_used = 1,
		/* listen for everything (broadcast mode used) */
		.filter.receiver_identity = 0,
	};

	err = nrf_modem_dect_phy_rx(&rx_op_params);
	if (err != 0) {
		return err;
	}

	return 0;
}

int dect_init(void) {
    int err;
	
	
	//uint32_t tx_counter_value = 0;
	

	LOG_INF("Dect NR+ PHY Hello sample started");

	err = nrf_modem_lib_init();
	if (err) {
		LOG_ERR("modem init failed, err %d", err);
		return err;
	}

	err = nrf_modem_dect_phy_callback_set(&dect_phy_callbacks);
	if (err) {
		LOG_ERR("nrf_modem_dect_phy_callback_set failed, err %d", err);
		return err;
	}

	err = nrf_modem_dect_phy_init(&dect_phy_init_params);
	if (err) {
		LOG_ERR("nrf_modem_dect_phy_init failed, err %d", err);
		return err;
	}

	k_sem_take(&operation_sem, K_FOREVER);
	if (exit) {
		return -EIO;
	}

	hwinfo_get_device_id((void *)&device_id, sizeof(device_id));

	LOG_INF("Dect NR+ PHY initialized, device ID: %d", device_id);

	err = nrf_modem_dect_phy_capability_get();
	if (err) {
		LOG_ERR("nrf_modem_dect_phy_capability_get failed, err %d", err);
	}
    return err;
}

int dect_close(void){
    int err;
    LOG_INF("Shutting down");

	err = nrf_modem_dect_phy_deinit();
	if (err) {
		LOG_ERR("nrf_modem_dect_phy_deinit() failed, err %d", err);
		return err;
	}

	k_sem_take(&operation_sem, K_FOREVER);

	err = nrf_modem_lib_shutdown();
	if (err) {
		LOG_ERR("nrf_modem_lib_shutdown() failed, err %d", err);
		return err;
	}

	LOG_INF("Bye!");
    return err;
}

int dect_send(dect_packet send_data){
    /** Transmitting message */
    
        uint32_t tx_handle = 0;
        
	    size_t tx_len = sizeof(send_data);
        uint8_t tx_buf[tx_len];
        int err;
		LOG_INF("Transmitting: %d bytes", tx_len);
        //LOG_INF("\t%s", (char*) string);
		//memcpy(tx_buf, (void*) string, tx_len);
        to_raw(send_data, tx_buf);

		err = transmit(tx_handle, tx_buf, tx_len);
		if (err) {
			LOG_ERR("Transmisstion failed, err %d", err);
			return err;
		}
        k_sem_take(&operation_sem, K_FOREVER);
        
        return err;
}

int dect_listen(void){
    int err;
    uint32_t rx_handle = 1;
    err = receive(rx_handle, true);
		if (err) {
			LOG_ERR("Reception failed, err %d", err);
			return err;
		}

		/* Wait for RX operation to complete. */
	k_sem_take(&operation_sem, K_FOREVER);
    return err;
}
int dect_listen_cont(void){
	int err;
    uint32_t rx_handle = 1;
    err = receive(rx_handle, false);
		if (err) {
			LOG_ERR("Reception failed, err %d", err);
			return err;
		}

		/* Wait for RX operation to complete. */
	k_sem_take(&operation_sem, K_FOREVER);
    return err;
}

void dect_data_callback(const void* data, int snr){
    
    dect_packet received_data = from_raw(data);
    LOG_INF("Received: %d bytes", sizeof(received_data));
    //float temperature = received_data.temperature;
    //LOG_INF("%llu Says the temperature is %.02f", received_data.hwid, (double)temperature);
    receipt_callback(received_data, snr);
    
    return;
}

dect_packet from_raw(const void* data){
    dect_packet out_data;
    memcpy(&out_data, data, sizeof(out_data));
    return out_data;
}

void to_raw(dect_packet data, void* buffer){
    dect_packet in_data = data;
    memcpy(buffer, &in_data, sizeof(data));
    return;
}

void dect_set_callback(dect_callback_t callback){
    receipt_callback = callback;
    return;
}
```

## src/dect-nr.h
```c
#include <string.h>
#include <zephyr/kernel.h>
#include <zephyr/logging/log.h>
#include <nrf_modem_dect_phy.h>
#include <modem/nrf_modem_lib.h>
#include <zephyr/drivers/hwinfo.h>

#ifndef DECTNR_H_

#define DATA_LEN_MAX 64


typedef struct {
    bool is_ping;
	bool is_request;
    uint16_t target_hwid;
    uint16_t hwid;
    uint16_t sender_hwid;
	uint16_t op_hwid;
	int16_t snr;
    int8_t temperature;
    uint8_t speed;
    float latitude;
    float longitude;
	int8_t accelX;
	int8_t accelY;
	int8_t accelZ;
	bool locked;
} dect_packet;



typedef int (*dect_callback_t)(dect_packet, int snr);

//uint16_t device_id;

/* Header type 1, due to endianness the order is different than in the specification. */
struct phy_ctrl_field_common {
	uint32_t packet_length : 4;
	uint32_t packet_length_type : 1;
	uint32_t header_format : 3;
	uint32_t short_network_id : 8;
	uint32_t transmitter_id_hi : 8;
	uint32_t transmitter_id_lo : 8;
	uint32_t df_mcs : 3;
	uint32_t reserved : 1;
	uint32_t transmit_power : 4;
	uint32_t pad : 24;
};



void dect_data_callback(const void* data, int snr);
void dect_set_callback(dect_callback_t callback);
int dect_init(void);
int dect_close(void);
int dect_send_s(char* string, size_t len);
int dect_send(dect_packet send_data);
int dect_listen_cont(void);
dect_packet from_raw(const void* data);
void to_raw(dect_packet data, void* buffer);
int dect_listen(void);

#endif

#define DECTNR_H_
```

## src/main.h
```c
#ifndef MAIN_H_
int switch_node_root(void);
#define MAIN_H_
#endif
```

## src/mesh-root.c
```c
/*
 * Copyright (c) 2024 Nordic Semiconductor ASA
 *
 * SPDX-License-Identifier: LicenseRef-Nordic-5-Clause
 */
#include <string.h>
#include <zephyr/kernel.h>
#include <zephyr/logging/log.h>
#include <nrf_modem_dect_phy.h>
#include <modem/nrf_modem_lib.h>
#include <zephyr/drivers/hwinfo.h>
#include "mesh-root.h"
#ifndef MESH_H_
#include "mesh.h"
#endif
#ifndef UART_H_
#include "uart.h"
#endif
#include <dk_buttons_and_leds.h>
#define NAN 0.0f/0.0f
#include "main.h"
#include <stdlib.h>


LOG_MODULE_REGISTER(MeshR_Module, LOG_LEVEL_INF);

sys_dlist_t* device_dlist;
device_in_list* my_node;





bool has_received_request_root;
static uint16_t hwid;
//static uint16_t my_index;
data_point* current_data;


int data_receipt_root(dect_packet data, int snr);
uint16_t device_waiting;
bool continue_listening;
//update_point* device_locks_mesh;

static void button_handler(uint32_t button_state, uint32_t has_changed)
{
	/* Send a GET request or PUT request upon button triggers */
	if (has_changed & DK_BTN1_MSK && button_state & DK_BTN1_MSK) 
	{
		device_in_list* s_ptr;
		device_in_list* current_ptr;
		SYS_DLIST_FOR_EACH_CONTAINER_SAFE(device_dlist, current_ptr, s_ptr, node){
			current_ptr->locked = !current_ptr->locked;
		}
	}
}

static void device_add(uint16_t hwid, bool locked){
	device_in_list* device = k_calloc(1, sizeof(device_in_list));
	sys_dnode_init(&(device->node));
	device->hwid = hwid;
	device->locked = locked;
	sys_dlist_prepend(device_dlist, &(device->node));
	LOG_INF("added %d", hwid);
}
static void device_remove(device_in_list* device){
	sys_dlist_remove(&(device->node));
	LOG_INF("removed %d", device->hwid);
	free(device);
}

int mesh_root(struct k_sem* mesh_sem, data_point* last_point, sys_dlist_t* device_list)
{
	sys_dlist_init(device_list); //Initialize the dlist and add itself to it
	LOG_INF("Init.");
	k_thread_suspend(k_current_get()); // DEFAULT IS NON_ROOT
	hwinfo_get_device_id((void *)&hwid, sizeof(hwid));

	//
	device_dlist = device_list;
	device_add(hwid, true);
	device_add(0, true);
	
	current_data = last_point;
	dk_buttons_init(button_handler);
	dk_leds_init();
	
	// for(int i = 0; i < NUM_DEVICES; i++){
	// 	update_point initial_update_point = {
	// 		.hwid = all_devices[i],
	// 		.locked = true
	// 	};
	// 	locks[i] = initial_update_point;
	// 	device_locks_mesh = locks;
	// }
	dect_init();
	
	dect_set_callback(&data_receipt_root);
	bool is_connected[NUM_DEVICES] = {false};

	LOG_INF("I am %u", hwid);
	while (1) {
		LOG_INF("***********************************");
		LOG_INF("I am %u", hwid);

		dect_packet ping_point = {
			.is_ping = true,
			.is_request = false,
			.hwid = hwid,
			.sender_hwid = hwid,
			.target_hwid = 0,
			.latitude = 0,
			.longitude = 0,
			.speed = 0,
			.accelX = 0,
			.accelY = 0,
			.accelZ = 0,
			.temperature = 0,
			.locked = false
		};
		dect_packet request_point = {
			.is_ping = false,
			.is_request = true,
			.hwid = 0,
			.sender_hwid = hwid,
			.target_hwid = 0,
			.latitude = 0,
			.longitude = 0,
			.speed = 0,
			.temperature = 0,
			.accelX = 0,
			.accelY = 0,
			.accelZ = 0,
			.locked = false
		};
		dect_packet ack_packet = {
			.is_ping = true,
			.is_request = true,
			.hwid = hwid,
			.sender_hwid = 0,
			.target_hwid = 0,
			.latitude = 0,
			.longitude = 0,
			.temperature = 0,
			.accelX = 0,
			.accelY = 0,
			.accelZ = 0,
			.speed = 0,
			.locked = false
		};
		dect_send(ping_point);
		
		LOG_INF("Mesh-building Complete.");
		k_msleep(CONCURRENCY_DELAY);
		LOG_INF("");

		// dect_packet* point_array = k_calloc(NUM_MAX_DEVICES, sizeof(dect_packet));
		// int counter = 0;
		// dect_packet* pointer = point_array;

		/** Receiving messages for CONFIG_RX_PERIOD_MS miliseconds. */
		// for(int i = 0; i < NUM_DEVICES; i++){ // send a request to each device and wait for it to respond.
		// 	k_msleep(30); // REMOVE FOR TESTING HIGHER SPEEDS
		// 	request_point.hwid = all_devices[i];
		// 	request_point.locked = locks[i].locked;
		// 	device_waiting = all_devices[i];
		// 	if(device_waiting == hwid){
		// 		continue;
		// 	}
		// 	has_received_request_root = false;
		// 	int err = dect_send(request_point);
		// 	while (err != 0)
		// 	{
		// 		dect_send(request_point);
		// 	}
			
		// 	LOG_INF("Request sent to device #%u", device_waiting);
			
		// 	continue_listening = false;
		// 	dect_listen();
			
		// 	while (continue_listening) {
		// 		continue_listening = false;
		// 		dect_listen();
		// 	}
			
		// 	if(!has_received_request_root){
		// 		LOG_ERR("Timed out.");
		// 		is_connected[i] = false;
		// 	}
		// 	if(has_received_request_root){
		// 		is_connected[i] = true;
		// 	}
		// 	k_msleep(CONCURRENCY_DELAY);
			
			
		// }
		device_in_list* s_ptr;
		device_in_list* current_ptr;
		SYS_DLIST_FOR_EACH_CONTAINER_SAFE(device_dlist, current_ptr, s_ptr, node){
			k_msleep(30); // REMOVE FOR TESTING HIGHER SPEEDS
			request_point.hwid = current_ptr->hwid;
			request_point.locked = current_ptr->locked;
			device_waiting = current_ptr->hwid;
			if(device_waiting == hwid){
				my_node = current_ptr;
				continue;
			}
			has_received_request_root = false;
			int err = dect_send(request_point);
			while (err != 0)
			{
				dect_send(request_point);
			}
			
			LOG_INF("Request sent to device #%u", device_waiting);
			
			if(device_waiting == 0){
				dect_listen_cont();
			} else {
				continue_listening = false;
				dect_listen();
				
				while (continue_listening) {
					continue_listening = false;
					dect_listen();
				}
			}
			
			
			
			if(!has_received_request_root && device_waiting != 0){
				LOG_ERR("Timed out."); // last request (0) should tiem out
				device_remove(current_ptr);
			}
			if(has_received_request_root){
				LOG_INF("Did not time out.");
			}
			k_msleep(CONCURRENCY_DELAY);
		}
		dect_send(ack_packet);
		LOG_INF("Receipt      Complete.");
		last_point->hwid = hwid;
		last_point->parent = 0;
		last_point->snr = 255;
		dk_set_led(DK_LED1, my_node->locked);
		uart_send_data(*last_point);
		LOG_INF("    Latitude:       %0.6f", (double)last_point->latitude);
		LOG_INF("    Longitude:      %0.6f", (double)last_point->longitude);
		LOG_INF("    Temperature:    %0.6f", (double)last_point->temperature);
		LOG_INF("    Accel:          [%0.2f, %0.2f, %0.2f]", (double)last_point->accelX, (double)last_point->accelY, (double)last_point->accelZ);
		LOG_INF("    Speed:          %0.6f", (double)last_point->speed);
		LOG_INF("    Signal:         %d", last_point->snr);
		LOG_INF("    Parent:         %d", last_point->parent);
		LOG_INF("    Locked:         NA");
		LOG_INF("Sent my own data via UART");
		LOG_INF("");
		//LOG_ERR("END");
		for(int i = 0; i < WAIT_BEFORE_NEXT_CYCLE / CONFIG_RX_PERIOD_MS; i++){
			dect_listen_cont();
		}
		k_msleep(ADDITIONAL_WAIT);
		k_msleep(rand()%64);

	}

	dect_close();

	return 0;
}

int data_receipt_root(dect_packet data, int snr){
	if(data.is_request && data.is_ping){
		LOG_INF("\tACK.");
		if(data.hwid != hwid){
			LOG_INF("--------------------Switching to node--------------------");
			switch_node_root();
		}
	} else if(data.is_request){
		LOG_INF("\trequest.");
	} else if(data.is_ping){
		LOG_INF("\tPing.");
	} else {
		LOG_INF("\tPacket from %d to %d.", data.sender_hwid, data.target_hwid);
	}
	if(!data.is_ping && data.target_hwid == hwid){ //if it's not a ping, store it.
		LOG_INF("Originator:              %u", data.hwid);
		LOG_INF("Sender:                  %u", data.sender_hwid);
		LOG_INF("Intended Target:         %u", data.target_hwid);
		//LOG_INF("Actual recipient (root): %u", hwid);
		LOG_INF("    Latitude:       %0.6f", (double)data.latitude);
		LOG_INF("    Longitude:      %0.6f", (double)data.longitude);
		LOG_INF("    Temperature:    %0.6f", (double)data.temperature);
		LOG_INF("    Accel:          [%0.2f, %0.2f, %0.2f]", (double)data.accelX, (double)data.accelY, (double)data.accelZ);
		LOG_INF("    Speed:          %0.6f", (double)data.speed);
		LOG_INF("    Signal:         %d", data.snr);
		LOG_INF("    Parent:         %d", data.op_hwid);
		LOG_INF("    Locked:         %d", (int)data.locked);
		data_point uart_out = {
			.hwid = data.hwid,
			.parent = data.op_hwid,
			.temperature = data.temperature,
			.speed = data.speed,
			.snr = data.snr,
			.latitude = data.latitude,
			.longitude = data.longitude,
			.accelX = data.accelX,
			.accelY = data.accelY,
			.accelZ = data.accelZ,
		};
		uart_send_data(uart_out);
		if(device_waiting == 0){
			device_add(data.hwid, data.locked);
		}
		has_received_request_root = true;
	} else {
		//LOG_INF("Ping.");
	}
	if(device_waiting == data.hwid && !data.is_request && !data.is_ping && data.target_hwid == hwid){ //The data packet is the form of sending the request back. This is counterintuitive but it's fine.
		//has_received_request_root = true;
	}
	else{
		continue_listening = true;
	}
	return 0;
}

int mesh_root_switch_init(void){
	dect_set_callback(&data_receipt_root);
	return 0;
}
```

## src/mesh-root.h
```c
#include "dect-nr.h"
#define MESHR_H_

#ifndef MESH_H_
#include "mesh.h"
#endif
#include <zephyr/sys/dlist.h>

int mesh_root(struct k_sem* mesh_sem, data_point* last_data_point, sys_dlist_t* devices);
int mesh_root_switch_init(void);

typedef struct {
    uint16_t hwid;
    bool locked;
    sys_dnode_t node;
} device_in_list;
```

## src/mesh.c
```c
/*
 * Copyright (c) 2024 Nordic Semiconductor ASA
 *
 * SPDX-License-Identifier: LicenseRef-Nordic-5-Clause
 */
#include <string.h>
#include <zephyr/kernel.h>
#include <zephyr/logging/log.h>
#include <nrf_modem_dect_phy.h>
#include <modem/nrf_modem_lib.h>
#include <zephyr/drivers/hwinfo.h>
#ifndef MESH_H_
#include "mesh.h"
#endif
#ifndef UART_H_
#include "uart.h"
#endif
#include <dk_buttons_and_leds.h>
#define NAN 0.0f/0.0f
#include "main.h"
#include <stdlib.h>

LOG_MODULE_REGISTER(MeshN_Module, LOG_LEVEL_INF);






bool has_received_ping;
bool has_a_child;
bool has_received_request_node;
bool is_added;
bool received_request_to_add;



dect_packet fwd_data;

static uint16_t hwid;
static uint16_t my_index;
int timeout_counter;

//extern uint16_t all_devices[] = {10639U, 32048U, 0U};






void concurrency_sleep(){
	k_usleep(CONCURRENCY_DELAY * 1000 + rand() % 4096);
}


int get_device_index(uint16_t input_hwid){
	
	return -1;
}

bool has_received_data;
int data_receipt_node(dect_packet data, int snr);
uint16_t parent; //used to identify leaf nodes.
dect_packet echo_packet;
uint16_t root_id;
bool has_received_ack;
data_point* sensor_data;
bool is_locked;

int mesh_node(data_point* sens_data, struct k_sem* mesh_sem)
{
	is_locked = true;
	dk_leds_init();
	
	k_sem_take(mesh_sem, K_FOREVER);
	sensor_data = sens_data;
	my_index = -1;
	dect_init();
	dect_set_callback(&data_receipt_node);
	hwinfo_get_device_id((void *)&hwid, sizeof(hwid));
	LOG_INF("Init");
	is_added = false;
	// for(int i = 0; i < NUM_DEVICES; i++){
	// 	if(all_devices[i] == hwid){
	// 		my_index = i;
	// 		LOG_INF("I am at index %d", i);
	// 		break;
	// 	}
	// 	if(my_index == -1){
	// 		LOG_ERR("Device is not in list. Please add it.");
	// 	}
	// }

	while (1) {
		
		LOG_INF("I am %u at #%d", hwid, my_index);
		LOG_INF("Waiting for ping from root.");
		has_received_ping = false;
		bool has_sent_ping = false;
		is_added = false;
		received_request_to_add = false;
		has_a_child = false;
		timeout_counter = 0;
		while(!has_received_ping){ // wait for a ping from the parent once the device is reachable.
			dect_listen();
			timeout_counter++;
			if(has_received_ping && !has_sent_ping){
				dect_packet out_data = {
					.is_ping = true,
					.hwid = root_id,
					.sender_hwid = hwid,
					.target_hwid = parent,
					.latitude = -0.0f,
					.longitude = -0.0f,
					.speed = 0,
					.temperature = 0,
					.op_hwid = 0,
					.locked = false
				};
				dect_send(out_data);
				has_sent_ping = true;
				LOG_INF("\tResponded.");
			}
			if(timeout_counter >= TIMEOUT_BECOME_ROOT/CONFIG_RX_PERIOD_MS){
				k_msleep(rand() % 32);
				LOG_INF("--------------------Switching to root--------------------");
				switch_node_root();
			}

		}
		
		LOG_INF("Mesh-building complete");

		//k_msleep(IDLE_TIME_BEFORE_SEND);

		//Now each non-root has a parent. The tree is formed

		has_received_data = false;

		dect_packet send_point = {
			.is_ping = false,
			.hwid = hwid, // HWID is the originator of the data
			.target_hwid = parent,
			.sender_hwid = hwid,
			.latitude =  sensor_data->latitude,
			.longitude = sensor_data->longitude,
			.speed = sensor_data->speed,
			.temperature = sensor_data->temperature,
			.snr = sensor_data->snr,
			.accelX = sensor_data->accelX,
			.accelY = sensor_data->accelY,
			.accelZ = sensor_data->accelZ,
			.op_hwid = parent,
			.locked = is_locked
		};
		
		// LOG_INF("Transmission Complete.");
		LOG_INF("");
		has_received_ack = false;
		has_received_ping = true;
		is_added = false;
		/** Receiving messages for CONFIG_RX_PERIOD_S seconds. */
		while(!has_received_ack){ // listen for 1 second to allow packets to propagata back up
			
			LOG_INF("Waiting for requests...");
			has_received_request_node = false;
			while(!has_received_request_node && !has_received_ack){
				dect_listen();
				if(has_received_data){
					//k_msleep(CONCURRENCY_DELAY);
					concurrency_sleep();
					LOG_INF("Forwarding data from %u to %u", echo_packet.sender_hwid, parent);
					dect_send(echo_packet);
					has_received_data = false;
				}
			}
			if(has_received_request_node){ //if it hasnt timed out
				if(echo_packet.hwid == 0 && !is_added) {
					k_msleep(1 + (rand() % 32));
					send_point.locked = is_locked;
					dect_send(send_point);
					
					LOG_INF("Received request to add myself, sent my data.");
					concurrency_sleep();
					is_added = true;
					dk_set_led(DK_LED1, is_locked);
					echo_packet.sender_hwid = hwid;
					dect_send(echo_packet);
					LOG_INF("Re-sent add request so everyone hears it.");
				} else if(echo_packet.hwid == hwid){
					k_msleep(15);
					is_locked = echo_packet.locked;
					send_point.locked = is_locked;
					//k_msleep(CONCURRENCY_DELAY*2);
					concurrency_sleep();
					dect_send(send_point);
					
					LOG_INF("Received request, sent my data.");
					concurrency_sleep();
					is_added = true;
					dk_set_led(DK_LED1, is_locked);
					echo_packet.sender_hwid = hwid;
					dect_send(echo_packet);
					LOG_INF("Re-sent my request so everyone hears it.");
				} else {
					concurrency_sleep();
					echo_packet.sender_hwid = hwid;
					dect_send(echo_packet);
					LOG_INF("Echoing request to ...%u", echo_packet.hwid%1000); // echo the request
				}
			} if(has_received_ack){
				dect_send(echo_packet);
				LOG_INF("ACK packet received and echoed");
			}
		}
		

		LOG_INF("Receipt      Complete.");
		LOG_INF("");
		k_sem_give(mesh_sem);
		k_msleep(WAIT_BEFORE_NEXT_CYCLE);
		

	}

	dect_close();

	return 0;
}

int data_receipt_node(dect_packet data, int snr){
	dect_packet in_data = data;
	// if(in_data.sender_hwid == 17754051359676071216){
	// 	return 0;
	// 	LOG_INF("\tRoot.");
	// }
	if(in_data.is_request && in_data.is_ping){
		has_received_ack = true;
		LOG_INF("\tACK.");
		in_data.sender_hwid = hwid;
		in_data.target_hwid = 0;
		echo_packet = in_data;
	}
	if(in_data.is_request){
		LOG_INF("\trequest.");
	} else if(in_data.is_ping){
		LOG_INF("\tPing.");
	} else {
		LOG_INF("\tPacket.");
	}
	if(in_data.is_ping && !in_data.is_request){
		
		//LOG_INF("\tPinged.");
		if(!has_received_ping){
			has_received_ping = true;
			parent = in_data.sender_hwid;
			root_id = in_data.hwid;
			LOG_INF("Ping received! parent %u, gparent %u", parent, in_data.target_hwid); // parent of sender is in target, will call this "grandparent"
			sensor_data->snr = snr;
		} else if(!has_a_child && in_data.target_hwid == hwid){ //if it hears a ping from a node that claims it as parent, it has a child
			has_a_child = true;
		}
		
	} else if(in_data.is_request && !has_received_request_node && has_received_ping) {
		//LOG_INF("\trequest.");
		if(in_data.sender_hwid == parent){
			has_received_request_node = true;
			received_request_to_add = (in_data.sender_hwid == 0);
			LOG_INF("Received request for %u", in_data.hwid);
			echo_packet = in_data;
		}
	} else if(!data.is_request && !data.is_ping) {
		//LOG_INF("\tPacket.");
		//if the packet is actually meant for this device
		if(in_data.target_hwid == hwid) { // transmit it back to the parent
			LOG_INF("Forwarding packet from %u to %u that originated from %u", in_data.sender_hwid, parent, in_data.hwid);
			in_data.sender_hwid = hwid;
			
			in_data.target_hwid = parent;
			//dect_send(in_data);
			echo_packet = in_data;
			has_received_data = true;
		}
	}
	return 0;
}

int mesh_node_switch_init(void){
	dect_set_callback(&data_receipt_node);
	timeout_counter = 0;
}
```

## src/mesh.h
```c
#include "dect-nr.h"
#define MESH_H_
#include <stdlib.h>

typedef struct {
    int16_t snr;
    uint16_t hwid;
    uint16_t parent;
    float latitude;
    float longitude;
    int8_t temperature;
    uint8_t speed;
    int8_t accelX;
    int8_t accelY;
    int8_t accelZ;
} data_point;
typedef struct {
    uint16_t hwid;
    bool locked;
} update_point;

//int a = sizeof(data_point);

#define WAIT_BEFORE_NEXT_CYCLE 5200
#define ADDITIONAL_WAIT 50
#define CONCURRENCY_DELAY 1
#define TIMEOUT_BECOME_ROOT 3*WAIT_BEFORE_NEXT_CYCLE

#define NUM_DEVICES 3
//device list
//extern uint16_t all_devices[NUM_DEVICES];


int mesh_node(data_point* sens_data, struct k_sem* mesh_sem);
int mesh_node_switch_init(void);
```

## src/uart.c
```c
#include <zephyr/kernel.h>
#include <zephyr/device.h>
#include <zephyr/devicetree.h>
#include <zephyr/drivers/gpio.h>
#include <zephyr/sys/printk.h>
/* STEP 3 - Include the header file of the UART driver in main.c */
#include <zephyr/drivers/uart.h>
#ifndef UART_H_
#include "uart.h"
#endif
#ifndef MESH_H_
#include "mesh.h"
#endif
#ifndef MESH_R_H
#include "mesh-root.h"
#endif
#include <zephyr/logging/log.h>
#include <zephyr/sys/dlist.h>


/* 1000 msec = 1 sec */
#define SLEEP_TIME_MS 1000

/* STEP 10.2 - Define the receiving timeout period */
#define RECEIVE_TIMEOUT 10000

#define BUFF_SIZE 24

/* STEP 10.1.2 - Define the receive buffer */
uint8_t* rx_buf_data_1;
uint8_t* rx_buf_data_2;
uint8_t* next_buf;
static uint8_t tx_buf[sizeof(data_point)] = {0};
sys_dlist_t* device_list_uart; // devices
const struct device *uart2 = DEVICE_DT_GET(DT_NODELABEL(uart1));
LOG_MODULE_REGISTER(UART_Module, LOG_LEVEL_INF);
data_point* last_data_point;

const struct uart_config uart_cfg = {
		.baudrate = 9600,
		.parity = UART_CFG_PARITY_NONE,
		.stop_bits = UART_CFG_STOP_BITS_1,
		.data_bits = UART_CFG_DATA_BITS_8,
		.flow_ctrl = UART_CFG_FLOW_CTRL_NONE
	};



static void uart_cb(const struct device *dev, struct uart_event *evt, void *user_data)
{
	LOG_INF("Callback called");
	switch (evt->type) {

	case UART_RX_RDY:
		if ((evt->data.rx.len) == 1) {

		} else if(evt->data.rx.len == sizeof(data_point)){
			
			void* in_data = &(evt->data.rx.buf[evt->data.rx.offset]);
			
			//printk("%x", *last_data_point);
			//*last_data_point = *((data_point*)in_data);
			memcpy((void*)last_data_point, in_data, sizeof(data_point));
			LOG_INF("UART data_point received: %d", evt->data.rx.offset);
		} else if(evt->data.rx.len == sizeof(update_point)){
			// void* in_data = &(evt->data.rx.buf[evt->data.rx.offset]);
			// update_point new_update_point = *((update_point*)in_data);

			void* in_data = &(evt->data.rx.buf[evt->data.rx.offset]);
			//LOG_INF("1");
			update_point new_update_point;
			memcpy(&new_update_point, in_data, sizeof(update_point));
			
			device_in_list* current_ptr;
			LOG_INF("%x", device_list_uart);
			SYS_DLIST_FOR_EACH_CONTAINER(device_list_uart, current_ptr, node){
				LOG_INF("wfwef");
				if(current_ptr && current_ptr->hwid == new_update_point.hwid){
					current_ptr->locked = new_update_point.locked;
					LOG_INF("State updated, [%d, %d]", current_ptr->hwid, current_ptr->locked);
				}
			}
			LOG_INF("UART update_point received %d [%d, %d]", evt->data.rx.offset, new_update_point.hwid, new_update_point.locked);
		} else {
			LOG_ERR("Malformed UART received (wrong length: %d)", evt->data.rx.len);
		}
		uart_rx_disable(uart2);
		uart_rx_enable(uart2, next_buf, BUFF_SIZE, RECEIVE_TIMEOUT);
		LOG_INF("switched buffers");
		if(next_buf == rx_buf_data_1){
			next_buf = rx_buf_data_2;
		} else {
			next_buf = rx_buf_data_1;
		}
		// uint8_t* old_buf = evt->data.rx_buf.buf;
		// uart_rx_buf_rsp(uart2, next_buf, BUFF_SIZE);
		// next_buf = old_buf;
		break;
	case UART_RX_BUF_REQUEST:
			LOG_INF("BRQ");
			//uart_rx_buf_rsp(uart2, next_buf, BUFF_SIZE);
			// LOG_INF("ewfiuhweiufh");
			break;
	case UART_RX_BUF_RELEASED:
		LOG_INF("BRL");
		//next_buf = evt->data.rx_buf.buf;
	break;
	case UART_RX_DISABLED:
		uart_rx_enable(uart2, next_buf, BUFF_SIZE, RECEIVE_TIMEOUT);
		break;
	default:
		break;
	}
}
int uart_send_data(data_point out_data){
    data_point tx_data = out_data;
    memcpy(tx_buf, &tx_data, sizeof(tx_data));
    LOG_INF("Sending data over UART1");
    if (!device_is_ready(uart2)){
		LOG_ERR("UART device not ready\r\n");
		return 1 ;
	}
    return uart_tx(uart2, tx_buf, sizeof(tx_buf), SYS_FOREVER_MS);
}

int uart_module_init(void){
    int err = uart_callback_set(uart2, uart_cb, NULL);
    if(err != 0){
        LOG_ERR("Callback set failed %d", err);
    } else {
		LOG_INF("Callback set success");
	}
    err = uart_configure(uart2, &uart_cfg);
	if(err != 0){
		LOG_ERR("UART config failed %d", err);
	}
	LOG_INF("UART Init Success");
    return 0;
}



int uart_main(data_point* uart_data_point, sys_dlist_t* devices){
	device_list_uart = devices;
	rx_buf_data_1 = k_calloc(BUFF_SIZE, sizeof(uint8_t));
	rx_buf_data_2 = k_calloc(BUFF_SIZE, sizeof(uint8_t));
	next_buf = rx_buf_data_2;
	uart_module_init();
	uart_rx_enable(uart2, rx_buf_data_1, BUFF_SIZE, RECEIVE_TIMEOUT);
	last_data_point = uart_data_point;
	
	return 0;
}
```

## src/uart.h
```c
#ifndef MESH_H_
#include "mesh.h"
#endif

#define UART_H_

int uart_send_data(data_point out_data);
int uart_module_init(void);


int uart_main(data_point* uart_data_point, sys_dlist_t* devices);
```
