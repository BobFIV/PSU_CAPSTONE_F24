## nrf9161dk/build/Kconfig/Kconfig.shield
```kconfig
osource "/home/jet_mouse/Desktop/CMPEN482/ncs-fund/v2.x.x/lesson6/fund_less6_exer1/boards/shields/*/Kconfig.shield"
osource "/home/jet_mouse/Desktop/CMPEN482/ncs-fund/v2.x.x/lesson6/fund_less6_exer1_solution/boards/shields/*/Kconfig.shield"
osource "/home/jet_mouse/ncs/v2.6.1/nrf/boards/shields/*/Kconfig.shield"
```

## nrf9161dk/build/Kconfig/Kconfig.sysbuild.modules
```kconfig
menu "nrf (/home/jet_mouse/ncs/v2.6.1/nrf)"
osource "/home/jet_mouse/ncs/v2.6.1/nrf/sysbuild/Kconfig.sysbuild"
config ZEPHYR_NRF_MODULE
	bool
	default y
endmenu
```

## nrf9161dk/build/Kconfig/arch/Kconfig
```kconfig
# Load arch Kconfig descriptions.
osource "/home/jet_mouse/ncs/v2.7.0/zephyr/arch/x86/Kconfig"
osource "/home/jet_mouse/ncs/v2.7.0/zephyr/arch/xtensa/Kconfig"
osource "/home/jet_mouse/ncs/v2.7.0/zephyr/arch/sparc/Kconfig"
osource "/home/jet_mouse/ncs/v2.7.0/zephyr/arch/riscv/Kconfig"
osource "/home/jet_mouse/ncs/v2.7.0/zephyr/arch/posix/Kconfig"
osource "/home/jet_mouse/ncs/v2.7.0/zephyr/arch/nios2/Kconfig"
osource "/home/jet_mouse/ncs/v2.7.0/zephyr/arch/mips/Kconfig"
osource "/home/jet_mouse/ncs/v2.7.0/zephyr/arch/arm64/Kconfig"
osource "/home/jet_mouse/ncs/v2.7.0/zephyr/arch/arm/Kconfig"
osource "/home/jet_mouse/ncs/v2.7.0/zephyr/arch/arc/Kconfig"
```

## nrf9161dk/build/Kconfig/soc/Kconfig
```kconfig
# Load Zephyr SoC Kconfig descriptions.
osource "/home/jet_mouse/ncs/v2.7.0/zephyr/soc/xlnx/zynqmp/Kconfig"
osource "/home/jet_mouse/ncs/v2.7.0/zephyr/soc/xlnx/zynq7000/Kconfig"
osource "/home/jet_mouse/ncs/v2.7.0/zephyr/soc/xen/Kconfig"
osource "/home/jet_mouse/ncs/v2.7.0/zephyr/soc/ti/simplelink/Kconfig"
osource "/home/jet_mouse/ncs/v2.7.0/zephyr/soc/ti/lm3s6965/Kconfig"
osource "/home/jet_mouse/ncs/v2.7.0/zephyr/soc/ti/k3/Kconfig"
osource "/home/jet_mouse/ncs/v2.7.0/zephyr/soc/telink/tlsr/Kconfig"
osource "/home/jet_mouse/ncs/v2.7.0/zephyr/soc/starfive/jh71xx/Kconfig"
osource "/home/jet_mouse/ncs/v2.7.0/zephyr/soc/st/stm32/Kconfig"
osource "/home/jet_mouse/ncs/v2.7.0/zephyr/soc/snps/qemu_arc/Kconfig"
osource "/home/jet_mouse/ncs/v2.7.0/zephyr/soc/snps/nsim/Kconfig"
osource "/home/jet_mouse/ncs/v2.7.0/zephyr/soc/snps/hsdk4xd/Kconfig"
osource "/home/jet_mouse/ncs/v2.7.0/zephyr/soc/snps/hsdk/Kconfig"
osource "/home/jet_mouse/ncs/v2.7.0/zephyr/soc/snps/emsk/Kconfig"
osource "/home/jet_mouse/ncs/v2.7.0/zephyr/soc/snps/emsdp/Kconfig"
osource "/home/jet_mouse/ncs/v2.7.0/zephyr/soc/snps/arc_iot/Kconfig"
osource "/home/jet_mouse/ncs/v2.7.0/zephyr/soc/silabs/Kconfig"
osource "/home/jet_mouse/ncs/v2.7.0/zephyr/soc/sifive/sifive_freedom/Kconfig"
osource "/home/jet_mouse/ncs/v2.7.0/zephyr/soc/rockchip/Kconfig"
osource "/home/jet_mouse/ncs/v2.7.0/zephyr/soc/renode/riscv_virtual/Kconfig"
osource "/home/jet_mouse/ncs/v2.7.0/zephyr/soc/renesas/smartbond/Kconfig"
osource "/home/jet_mouse/ncs/v2.7.0/zephyr/soc/renesas/rzt2m/Kconfig"
osource "/home/jet_mouse/ncs/v2.7.0/zephyr/soc/renesas/rcar/Kconfig"
osource "/home/jet_mouse/ncs/v2.7.0/zephyr/soc/renesas/ra/Kconfig"
osource "/home/jet_mouse/ncs/v2.7.0/zephyr/soc/raspberrypi/Kconfig"
osource "/home/jet_mouse/ncs/v2.7.0/zephyr/soc/quicklogic/eos_s3/Kconfig"
osource "/home/jet_mouse/ncs/v2.7.0/zephyr/soc/qemu/virt_riscv/Kconfig"
osource "/home/jet_mouse/ncs/v2.7.0/zephyr/soc/qemu/malta/Kconfig"
osource "/home/jet_mouse/ncs/v2.7.0/zephyr/soc/openisa/rv32m1/Kconfig"
osource "/home/jet_mouse/ncs/v2.7.0/zephyr/soc/nxp/s32/Kconfig"
osource "/home/jet_mouse/ncs/v2.7.0/zephyr/soc/nxp/rw/Kconfig"
osource "/home/jet_mouse/ncs/v2.7.0/zephyr/soc/nxp/mcx/Kconfig"
osource "/home/jet_mouse/ncs/v2.7.0/zephyr/soc/nxp/lpc/Kconfig"
osource "/home/jet_mouse/ncs/v2.7.0/zephyr/soc/nxp/layerscape/Kconfig"
osource "/home/jet_mouse/ncs/v2.7.0/zephyr/soc/nxp/kinetis/Kconfig"
osource "/home/jet_mouse/ncs/v2.7.0/zephyr/soc/nxp/imxrt/Kconfig"
osource "/home/jet_mouse/ncs/v2.7.0/zephyr/soc/nxp/imx/Kconfig"
osource "/home/jet_mouse/ncs/v2.7.0/zephyr/soc/nuvoton/numicro/Kconfig"
osource "/home/jet_mouse/ncs/v2.7.0/zephyr/soc/nuvoton/numaker/Kconfig"
osource "/home/jet_mouse/ncs/v2.7.0/zephyr/soc/nuvoton/npcx/Kconfig"
osource "/home/jet_mouse/ncs/v2.7.0/zephyr/soc/nordic/Kconfig"
osource "/home/jet_mouse/ncs/v2.7.0/zephyr/soc/neorv32/Kconfig"
osource "/home/jet_mouse/ncs/v2.7.0/zephyr/soc/native/inf_clock/Kconfig"
osource "/home/jet_mouse/ncs/v2.7.0/zephyr/soc/microchip/miv/Kconfig"
osource "/home/jet_mouse/ncs/v2.7.0/zephyr/soc/microchip/mec/Kconfig"
osource "/home/jet_mouse/ncs/v2.7.0/zephyr/soc/lowrisc/opentitan/Kconfig"
osource "/home/jet_mouse/ncs/v2.7.0/zephyr/soc/litex/litex_vexriscv/Kconfig"
osource "/home/jet_mouse/ncs/v2.7.0/zephyr/soc/ite/ec/Kconfig"
osource "/home/jet_mouse/ncs/v2.7.0/zephyr/soc/intel/raptor_lake/Kconfig"
osource "/home/jet_mouse/ncs/v2.7.0/zephyr/soc/intel/lakemont/Kconfig"
osource "/home/jet_mouse/ncs/v2.7.0/zephyr/soc/intel/intel_socfpga_std/Kconfig"
osource "/home/jet_mouse/ncs/v2.7.0/zephyr/soc/intel/intel_socfpga/Kconfig"
osource "/home/jet_mouse/ncs/v2.7.0/zephyr/soc/intel/intel_niosv/Kconfig"
osource "/home/jet_mouse/ncs/v2.7.0/zephyr/soc/intel/intel_ish/Kconfig"
osource "/home/jet_mouse/ncs/v2.7.0/zephyr/soc/intel/intel_adsp/Kconfig"
osource "/home/jet_mouse/ncs/v2.7.0/zephyr/soc/intel/elkhart_lake/Kconfig"
osource "/home/jet_mouse/ncs/v2.7.0/zephyr/soc/intel/atom/Kconfig"
osource "/home/jet_mouse/ncs/v2.7.0/zephyr/soc/intel/apollo_lake/Kconfig"
osource "/home/jet_mouse/ncs/v2.7.0/zephyr/soc/intel/alder_lake/Kconfig"
osource "/home/jet_mouse/ncs/v2.7.0/zephyr/soc/infineon/cat3/Kconfig"
osource "/home/jet_mouse/ncs/v2.7.0/zephyr/soc/infineon/cat1a/Kconfig"
osource "/home/jet_mouse/ncs/v2.7.0/zephyr/soc/gd/gd32/Kconfig"
osource "/home/jet_mouse/ncs/v2.7.0/zephyr/soc/gaisler/leon3/Kconfig"
osource "/home/jet_mouse/ncs/v2.7.0/zephyr/soc/gaisler/gr716a/Kconfig"
osource "/home/jet_mouse/ncs/v2.7.0/zephyr/soc/espressif/Kconfig"
osource "/home/jet_mouse/ncs/v2.7.0/zephyr/soc/ene/kb1200/Kconfig"
osource "/home/jet_mouse/ncs/v2.7.0/zephyr/soc/efinix/sapphire/Kconfig"
osource "/home/jet_mouse/ncs/v2.7.0/zephyr/soc/cdns/xtensa_sample_controller/Kconfig"
osource "/home/jet_mouse/ncs/v2.7.0/zephyr/soc/cdns/dc233c/Kconfig"
osource "/home/jet_mouse/ncs/v2.7.0/zephyr/soc/brcm/bcmvk/Kconfig"
osource "/home/jet_mouse/ncs/v2.7.0/zephyr/soc/brcm/bcm2712/Kconfig"
osource "/home/jet_mouse/ncs/v2.7.0/zephyr/soc/brcm/bcm2711/Kconfig"
osource "/home/jet_mouse/ncs/v2.7.0/zephyr/soc/atmel/sam0/Kconfig"
osource "/home/jet_mouse/ncs/v2.7.0/zephyr/soc/atmel/sam/Kconfig"
osource "/home/jet_mouse/ncs/v2.7.0/zephyr/soc/aspeed/Kconfig"
osource "/home/jet_mouse/ncs/v2.7.0/zephyr/soc/arm/Kconfig"
osource "/home/jet_mouse/ncs/v2.7.0/zephyr/soc/arm/beetle/Kconfig"
osource "/home/jet_mouse/ncs/v2.7.0/zephyr/soc/andestech/Kconfig"
osource "/home/jet_mouse/ncs/v2.7.0/zephyr/soc/ambiq/Kconfig"
osource "/home/jet_mouse/ncs/v2.7.0/zephyr/soc/altr/zephyr_nios2f/Kconfig"
osource "/home/jet_mouse/ncs/v2.7.0/zephyr/soc/altr/qemu_nios2/Kconfig"
```

## nrf9161dk/build/Kconfig/soc/Kconfig.defconfig
```kconfig
# Load Zephyr SoC Kconfig defconfig.
osource "/home/jet_mouse/ncs/v2.7.0/zephyr/soc/xlnx/zynqmp/Kconfig.defconfig"
osource "/home/jet_mouse/ncs/v2.7.0/zephyr/soc/xlnx/zynq7000/Kconfig.defconfig"
osource "/home/jet_mouse/ncs/v2.7.0/zephyr/soc/xen/Kconfig.defconfig"
osource "/home/jet_mouse/ncs/v2.7.0/zephyr/soc/ti/simplelink/Kconfig.defconfig"
osource "/home/jet_mouse/ncs/v2.7.0/zephyr/soc/ti/lm3s6965/Kconfig.defconfig"
osource "/home/jet_mouse/ncs/v2.7.0/zephyr/soc/ti/k3/Kconfig.defconfig"
osource "/home/jet_mouse/ncs/v2.7.0/zephyr/soc/telink/tlsr/Kconfig.defconfig"
osource "/home/jet_mouse/ncs/v2.7.0/zephyr/soc/starfive/jh71xx/Kconfig.defconfig"
osource "/home/jet_mouse/ncs/v2.7.0/zephyr/soc/st/stm32/Kconfig.defconfig"
osource "/home/jet_mouse/ncs/v2.7.0/zephyr/soc/snps/qemu_arc/Kconfig.defconfig"
osource "/home/jet_mouse/ncs/v2.7.0/zephyr/soc/snps/nsim/Kconfig.defconfig"
osource "/home/jet_mouse/ncs/v2.7.0/zephyr/soc/snps/hsdk4xd/Kconfig.defconfig"
osource "/home/jet_mouse/ncs/v2.7.0/zephyr/soc/snps/hsdk/Kconfig.defconfig"
osource "/home/jet_mouse/ncs/v2.7.0/zephyr/soc/snps/emsk/Kconfig.defconfig"
osource "/home/jet_mouse/ncs/v2.7.0/zephyr/soc/snps/emsdp/Kconfig.defconfig"
osource "/home/jet_mouse/ncs/v2.7.0/zephyr/soc/snps/arc_iot/Kconfig.defconfig"
osource "/home/jet_mouse/ncs/v2.7.0/zephyr/soc/silabs/Kconfig.defconfig"
osource "/home/jet_mouse/ncs/v2.7.0/zephyr/soc/sifive/sifive_freedom/Kconfig.defconfig"
osource "/home/jet_mouse/ncs/v2.7.0/zephyr/soc/rockchip/Kconfig.defconfig"
osource "/home/jet_mouse/ncs/v2.7.0/zephyr/soc/renode/riscv_virtual/Kconfig.defconfig"
osource "/home/jet_mouse/ncs/v2.7.0/zephyr/soc/renesas/smartbond/Kconfig.defconfig"
osource "/home/jet_mouse/ncs/v2.7.0/zephyr/soc/renesas/rzt2m/Kconfig.defconfig"
osource "/home/jet_mouse/ncs/v2.7.0/zephyr/soc/renesas/rcar/Kconfig.defconfig"
osource "/home/jet_mouse/ncs/v2.7.0/zephyr/soc/renesas/ra/Kconfig.defconfig"
osource "/home/jet_mouse/ncs/v2.7.0/zephyr/soc/raspberrypi/Kconfig.defconfig"
osource "/home/jet_mouse/ncs/v2.7.0/zephyr/soc/quicklogic/eos_s3/Kconfig.defconfig"
osource "/home/jet_mouse/ncs/v2.7.0/zephyr/soc/qemu/virt_riscv/Kconfig.defconfig"
osource "/home/jet_mouse/ncs/v2.7.0/zephyr/soc/qemu/malta/Kconfig.defconfig"
osource "/home/jet_mouse/ncs/v2.7.0/zephyr/soc/openisa/rv32m1/Kconfig.defconfig"
osource "/home/jet_mouse/ncs/v2.7.0/zephyr/soc/nxp/s32/Kconfig.defconfig"
osource "/home/jet_mouse/ncs/v2.7.0/zephyr/soc/nxp/rw/Kconfig.defconfig"
osource "/home/jet_mouse/ncs/v2.7.0/zephyr/soc/nxp/mcx/Kconfig.defconfig"
osource "/home/jet_mouse/ncs/v2.7.0/zephyr/soc/nxp/lpc/Kconfig.defconfig"
osource "/home/jet_mouse/ncs/v2.7.0/zephyr/soc/nxp/layerscape/Kconfig.defconfig"
osource "/home/jet_mouse/ncs/v2.7.0/zephyr/soc/nxp/kinetis/Kconfig.defconfig"
osource "/home/jet_mouse/ncs/v2.7.0/zephyr/soc/nxp/imxrt/Kconfig.defconfig"
osource "/home/jet_mouse/ncs/v2.7.0/zephyr/soc/nxp/imx/Kconfig.defconfig"
osource "/home/jet_mouse/ncs/v2.7.0/zephyr/soc/nuvoton/numicro/Kconfig.defconfig"
osource "/home/jet_mouse/ncs/v2.7.0/zephyr/soc/nuvoton/numaker/Kconfig.defconfig"
osource "/home/jet_mouse/ncs/v2.7.0/zephyr/soc/nuvoton/npcx/Kconfig.defconfig"
osource "/home/jet_mouse/ncs/v2.7.0/zephyr/soc/nordic/Kconfig.defconfig"
osource "/home/jet_mouse/ncs/v2.7.0/zephyr/soc/neorv32/Kconfig.defconfig"
osource "/home/jet_mouse/ncs/v2.7.0/zephyr/soc/native/inf_clock/Kconfig.defconfig"
osource "/home/jet_mouse/ncs/v2.7.0/zephyr/soc/microchip/miv/Kconfig.defconfig"
osource "/home/jet_mouse/ncs/v2.7.0/zephyr/soc/microchip/mec/Kconfig.defconfig"
osource "/home/jet_mouse/ncs/v2.7.0/zephyr/soc/lowrisc/opentitan/Kconfig.defconfig"
osource "/home/jet_mouse/ncs/v2.7.0/zephyr/soc/litex/litex_vexriscv/Kconfig.defconfig"
osource "/home/jet_mouse/ncs/v2.7.0/zephyr/soc/ite/ec/Kconfig.defconfig"
osource "/home/jet_mouse/ncs/v2.7.0/zephyr/soc/intel/raptor_lake/Kconfig.defconfig"
osource "/home/jet_mouse/ncs/v2.7.0/zephyr/soc/intel/lakemont/Kconfig.defconfig"
osource "/home/jet_mouse/ncs/v2.7.0/zephyr/soc/intel/intel_socfpga_std/Kconfig.defconfig"
osource "/home/jet_mouse/ncs/v2.7.0/zephyr/soc/intel/intel_socfpga/Kconfig.defconfig"
osource "/home/jet_mouse/ncs/v2.7.0/zephyr/soc/intel/intel_niosv/Kconfig.defconfig"
osource "/home/jet_mouse/ncs/v2.7.0/zephyr/soc/intel/intel_ish/Kconfig.defconfig"
osource "/home/jet_mouse/ncs/v2.7.0/zephyr/soc/intel/intel_adsp/Kconfig.defconfig"
osource "/home/jet_mouse/ncs/v2.7.0/zephyr/soc/intel/elkhart_lake/Kconfig.defconfig"
osource "/home/jet_mouse/ncs/v2.7.0/zephyr/soc/intel/atom/Kconfig.defconfig"
osource "/home/jet_mouse/ncs/v2.7.0/zephyr/soc/intel/apollo_lake/Kconfig.defconfig"
osource "/home/jet_mouse/ncs/v2.7.0/zephyr/soc/intel/alder_lake/Kconfig.defconfig"
osource "/home/jet_mouse/ncs/v2.7.0/zephyr/soc/infineon/cat3/Kconfig.defconfig"
osource "/home/jet_mouse/ncs/v2.7.0/zephyr/soc/infineon/cat1a/Kconfig.defconfig"
osource "/home/jet_mouse/ncs/v2.7.0/zephyr/soc/gd/gd32/Kconfig.defconfig"
osource "/home/jet_mouse/ncs/v2.7.0/zephyr/soc/gaisler/leon3/Kconfig.defconfig"
osource "/home/jet_mouse/ncs/v2.7.0/zephyr/soc/gaisler/gr716a/Kconfig.defconfig"
osource "/home/jet_mouse/ncs/v2.7.0/zephyr/soc/espressif/Kconfig.defconfig"
osource "/home/jet_mouse/ncs/v2.7.0/zephyr/soc/ene/kb1200/Kconfig.defconfig"
osource "/home/jet_mouse/ncs/v2.7.0/zephyr/soc/efinix/sapphire/Kconfig.defconfig"
osource "/home/jet_mouse/ncs/v2.7.0/zephyr/soc/cdns/xtensa_sample_controller/Kconfig.defconfig"
osource "/home/jet_mouse/ncs/v2.7.0/zephyr/soc/cdns/dc233c/Kconfig.defconfig"
osource "/home/jet_mouse/ncs/v2.7.0/zephyr/soc/brcm/bcmvk/Kconfig.defconfig"
osource "/home/jet_mouse/ncs/v2.7.0/zephyr/soc/brcm/bcm2712/Kconfig.defconfig"
osource "/home/jet_mouse/ncs/v2.7.0/zephyr/soc/brcm/bcm2711/Kconfig.defconfig"
osource "/home/jet_mouse/ncs/v2.7.0/zephyr/soc/atmel/sam0/Kconfig.defconfig"
osource "/home/jet_mouse/ncs/v2.7.0/zephyr/soc/atmel/sam/Kconfig.defconfig"
osource "/home/jet_mouse/ncs/v2.7.0/zephyr/soc/aspeed/Kconfig.defconfig"
osource "/home/jet_mouse/ncs/v2.7.0/zephyr/soc/arm/Kconfig.defconfig"
osource "/home/jet_mouse/ncs/v2.7.0/zephyr/soc/arm/beetle/Kconfig.defconfig"
osource "/home/jet_mouse/ncs/v2.7.0/zephyr/soc/andestech/Kconfig.defconfig"
osource "/home/jet_mouse/ncs/v2.7.0/zephyr/soc/ambiq/Kconfig.defconfig"
osource "/home/jet_mouse/ncs/v2.7.0/zephyr/soc/altr/zephyr_nios2f/Kconfig.defconfig"
osource "/home/jet_mouse/ncs/v2.7.0/zephyr/soc/altr/qemu_nios2/Kconfig.defconfig"
```
